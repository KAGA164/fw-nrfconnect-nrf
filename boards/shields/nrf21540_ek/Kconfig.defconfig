## boards/shields/nrf21540_ek/Kconfig.defconfig
```kconfig
#
# Copyright (c) 2021 Nordic Semiconductor ASA
#
# SPDX-License-Identifier: LicenseRef-Nordic-5-Clause
#

if SHIELD_NRF21540_EK

config SPI
	default y

endif # SHIELD_NRF21540_EK
```
