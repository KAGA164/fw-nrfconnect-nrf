## CMakeLists.txt
```
#
# Copyright (c) 2018 Nordic Semiconductor
#
# SPDX-License-Identifier: LicenseRef-Nordic-5-Clause
#
cmake_minimum_required(VERSION 3.13.1)

find_package(Zephyr REQUIRED HINTS $ENV{ZEPHYR_BASE})
project(NONE)

# NORDIC SDK APP START
target_sources(app PRIVATE
  src/main.c
  src/temperature.c
)
# NORDIC SDK APP END
zephyr_library_include_directories(.)
```

## Kconfig
```
#
# Copyright (c) 2021 Nordic Semiconductor
#
# SPDX-License-Identifier: LicenseRef-Nordic-5-Clause
#

source "Kconfig.zephyr"

menu "Nordic Temperature BLE GATT service sample"

module = BT_TEMPERATURE
module-str = TEMPERATURE
source "${ZEPHYR_BASE}/subsys/logging/Kconfig.template.log_config"

endmenu
```

## prj.conf
```kconfig
#
# Copyright (c) 2021 Nordic Semiconductor
#
# SPDX-License-Identifier: LicenseRef-Nordic-5-Clause
#
CONFIG_NCS_SAMPLES_DEFAULTS=y

CONFIG_BT=y
CONFIG_BT_PERIPHERAL=y
CONFIG_BT_DEVICE_NAME="Nordic_temperature"
CONFIG_BT_SMP=y
CONFIG_BT_MAX_CONN=1
CONFIG_BT_MAX_PAIRED=1

# Enable bonding
CONFIG_BT_SETTINGS=y
CONFIG_FLASH=y
CONFIG_FLASH_PAGE_LAYOUT=y
CONFIG_FLASH_MAP=y
CONFIG_NVS=y
CONFIG_SETTINGS=y

CONFIG_DK_LIBRARY=y

CONFIG_ADC=y

CONFIG_SYSTEM_WORKQUEUE_STACK_SIZE=2048
```

## src/main.c
```c
/*
 * Copyright (c) 2021 Nordic Semiconductor ASA
 *
 * SPDX-License-Identifier: LicenseRef-Nordic-5-Clause
 */

#include <zephyr/types.h>
#include <stddef.h>
#include <string.h>
#include <errno.h>
#include <sys/printk.h>
#include <sys/byteorder.h>
#include <zephyr.h>
#include <drivers/gpio.h>
#include <drivers/adc.h>
#include <soc.h>

#include <hal/nrf_saadc.h>

#include <bluetooth/bluetooth.h>
#include <bluetooth/hci.h>
#include <bluetooth/conn.h>
#include <bluetooth/uuid.h>
#include <bluetooth/gatt.h>

#include <settings/settings.h>

#include <dk_buttons_and_leds.h>

#include "temperature.h"

#define DEVICE_NAME             CONFIG_BT_DEVICE_NAME
#define DEVICE_NAME_LEN         (sizeof(DEVICE_NAME) - 1)

#define RUN_STATUS_LED          DK_LED1
#define CON_STATUS_LED          DK_LED2

#define ADC_DEVICE_NAME		DT_LABEL(DT_NODELABEL(adc))
#define ADC_RESOLUTION		12
#define ADC_OVERSAMPLING	4 /* 2^ADC_OVERSAMPLING samples are averaged */
#define ADC_MAX 		4096
#define ADC_GAIN		ADC_GAIN_1_6
#define ADC_REFERENCE		ADC_REF_INTERNAL
#define ADC_ACQUISITION_TIME	ADC_ACQ_TIME_DEFAULT
#define ADC_CHANNEL_ID		1
#define ADC_CHANNEL_INPUT	NRF_SAADC_INPUT_AIN1

static const struct bt_data ad[] = {
	BT_DATA_BYTES(BT_DATA_FLAGS, (BT_LE_AD_GENERAL | BT_LE_AD_NO_BREDR)),
	BT_DATA(BT_DATA_NAME_COMPLETE, DEVICE_NAME, DEVICE_NAME_LEN),
};

static const struct bt_data sd[] = {
	BT_DATA_BYTES(BT_DATA_UUID128_ALL, BT_UUID_CUSTOM_TEMP_VAL),
};

static const struct device *adc_dev;
static int16_t adc_buffer;
static uint32_t meas_interval = 1000;

static int adc_init(void)
{
	int err;

	adc_dev = device_get_binding(ADC_DEVICE_NAME);
	if (!adc_dev) {
		printk("Cannot get ADC device\n");
		return -ENXIO;
	}

	static const struct adc_channel_cfg channel_cfg = {
		.gain             = ADC_GAIN,
		.reference        = ADC_REFERENCE,
		.acquisition_time = ADC_ACQUISITION_TIME,
		.channel_id       = ADC_CHANNEL_ID,
#if defined(CONFIG_ADC_CONFIGURABLE_INPUTS)
		.input_positive   = ADC_CHANNEL_INPUT,
#endif
	};

	err = adc_channel_setup(adc_dev, &channel_cfg);
	if (err) {
		printk("Setting up the ADC channel failed\n");
		return err;
	}

	return 0;
}

static int temperature_measure(uint32_t *temperature)
{
	int err;
	int32_t val = 0;

	static const struct adc_sequence sequence = {
		.options	= NULL,
		.channels	= BIT(ADC_CHANNEL_ID),
		.buffer		= &adc_buffer,
		.buffer_size	= sizeof(adc_buffer),
		.resolution	= ADC_RESOLUTION,
		.oversampling	= ADC_OVERSAMPLING,
		.calibrate	= false,
	};

	err = adc_read(adc_dev, &sequence);
	if (err) {
		printk("Temperature read failed\n");
		return err;
	}

	val = adc_buffer;

	err = adc_raw_to_millivolts(adc_ref_internal(adc_dev),
				    ADC_GAIN,
				    ADC_RESOLUTION,
				    &val);
	if (err) {
		printk("Cannot calculate temperature value in mV\n");
		return err;
	}

	*temperature = ((val * 147) - (1375 * 100)) / (225);

	return 0;
}


static void connected(struct bt_conn *conn, uint8_t err)
{
	if (err) {
		printk("Connection failed (err %u)\n", err);
		return;
	}

	printk("Connected\n");

	dk_set_led_on(CON_STATUS_LED);
}

static void disconnected(struct bt_conn *conn, uint8_t reason)
{
	printk("Disconnected (reason %u)\n", reason);

	dk_set_led_off(CON_STATUS_LED);
}

static void security_changed(struct bt_conn *conn, bt_security_t level,
			     enum bt_security_err err)
{
	char addr[BT_ADDR_LE_STR_LEN];

	bt_addr_le_to_str(bt_conn_get_dst(conn), addr, sizeof(addr));

	if (!err) {
		printk("Security changed: %s level %u\n", addr, level);
	} else {
		printk("Security failed: %s level %u err %d\n", addr, level,
			err);
	}
}
static struct bt_conn_cb conn_callbacks = {
	.connected        = connected,
	.disconnected     = disconnected,
	.security_changed = security_changed,
};

static void auth_passkey_display(struct bt_conn *conn, unsigned int passkey)
{
	char addr[BT_ADDR_LE_STR_LEN];

	bt_addr_le_to_str(bt_conn_get_dst(conn), addr, sizeof(addr));

	printk("Passkey for %s: %06u\n", addr, passkey);
}

static void auth_cancel(struct bt_conn *conn)
{
	char addr[BT_ADDR_LE_STR_LEN];

	bt_addr_le_to_str(bt_conn_get_dst(conn), addr, sizeof(addr));

	printk("Pairing cancelled: %s\n", addr);
}

static void pairing_confirm(struct bt_conn *conn)
{
	char addr[BT_ADDR_LE_STR_LEN];

	bt_addr_le_to_str(bt_conn_get_dst(conn), addr, sizeof(addr));

	bt_conn_auth_pairing_confirm(conn);

	printk("Pairing confirmed: %s\n", addr);
}

static void pairing_complete(struct bt_conn *conn, bool bonded)
{
	char addr[BT_ADDR_LE_STR_LEN];

	bt_addr_le_to_str(bt_conn_get_dst(conn), addr, sizeof(addr));

	printk("Pairing completed: %s, bonded: %d\n", addr, bonded);
}

static void pairing_failed(struct bt_conn *conn, enum bt_security_err reason)
{
	char addr[BT_ADDR_LE_STR_LEN];

	bt_addr_le_to_str(bt_conn_get_dst(conn), addr, sizeof(addr));

	printk("Pairing failed conn: %s, reason %d\n", addr, reason);
}

static struct bt_conn_auth_cb conn_auth_callbacks = {
	.passkey_display = auth_passkey_display,
	.cancel = auth_cancel,
	.pairing_confirm = pairing_confirm,
	.pairing_complete = pairing_complete,
	.pairing_failed = pairing_failed
};

static void temperature_meas_interval_change(const uint32_t interval)
{
	printk("Received measurement interval: %d ms\n", interval);

	meas_interval = interval;
}

static uint32_t temperature_read(void)
{
	int err;
	uint32_t temp;

	err = temperature_measure(&temp);
	if (err) {
		printk("Temperature measure failed (err %d)\n", err);
		return 0;
	}

	printk("Read temperature value: %d.%d C\n", temp / 10, temp % 10);

	return temp;
}

static const struct bt_temperature_cb temperature_callbacks = {
	.interval_cb = temperature_meas_interval_change,
	.temperature_cb = temperature_read
};

void main(void)
{
	int blink_status = 0;
	int err;

	printk("Starting Bluetooth temperature measurements\n");

	err = dk_leds_init();
	if (err) {
		printk("LEDs init failed (err %d)\n", err);
		return;
	}

	err = adc_init();
	if (err) {
		printk("ADC init failed (err %d)\n", err);
		return;
	}

	bt_conn_cb_register(&conn_callbacks);
	if (IS_ENABLED(CONFIG_BT_LBS_SECURITY_ENABLED)) {
		bt_conn_auth_cb_register(&conn_auth_callbacks);
	}

	err = bt_enable(NULL);
	if (err) {
		printk("Bluetooth init failed (err %d)\n", err);
		return;
	}

	printk("Bluetooth initialized\n");

	if (IS_ENABLED(CONFIG_SETTINGS)) {
		settings_load();
	}

	err = bt_temperature_init(&temperature_callbacks);
	if (err) {
		printk("Failed to init LBS (err:%d)\n", err);
		return;
	}

	err = bt_le_adv_start(BT_LE_ADV_CONN, ad, ARRAY_SIZE(ad),
			      sd, ARRAY_SIZE(sd));
	if (err) {
		printk("Advertising failed to start (err %d)\n", err);
		return;
	}

	printk("Advertising successfully started\n");

	for (;;) {
		uint32_t temp = 0;

		dk_set_led(RUN_STATUS_LED, (++blink_status) % 2);

		err = temperature_measure(&temp);
		if (err) {
			printk("Temperature measure failed (err %d)\n", err);
		}

		printk("Temperature: %d.%d C\n", (temp / 10), (temp % 10));

		bt_temperature_send_value(temp);

		k_sleep(K_MSEC(meas_interval));
	}
}
```

## src/temperature.c
```c
/*
 * Copyright (c) 2021 Nordic Semiconductor ASA
 *
 * SPDX-License-Identifier: LicenseRef-Nordic-5-Clause
 */

#include <zephyr/types.h>
#include <stddef.h>
#include <string.h>
#include <errno.h>
#include <sys/printk.h>
#include <sys/byteorder.h>
#include <zephyr.h>

#include <bluetooth/bluetooth.h>
#include <bluetooth/hci.h>
#include <bluetooth/conn.h>
#include <bluetooth/uuid.h>
#include <bluetooth/gatt.h>

#include "temperature.h"

#include <logging/log.h>

LOG_MODULE_REGISTER(bt_temperature, CONFIG_BT_TEMPERATURE_LOG_LEVEL);

static bool notify_enabled;
static const struct bt_temperature_cb *cb;

static void temperature_ccc_cfg_changed(const struct bt_gatt_attr *attr,
					uint16_t value)
{
	notify_enabled = (value == BT_GATT_CCC_NOTIFY);
}

static ssize_t write_interval(struct bt_conn *conn,
			      const struct bt_gatt_attr *attr,
			      const void *buf,
			      uint16_t len, uint16_t offset, uint8_t flags)
{
	LOG_DBG("Attribute write, handle: %u, conn: %p", attr->handle, conn);

	if (cb->interval_cb) {
		cb->interval_cb(*(uint32_t *)buf);
	}

	return len;
}

static ssize_t read_temperature(struct bt_conn *conn,
				const struct bt_gatt_attr *attr,
				void *buf,
				uint16_t len,
			  	uint16_t offset)
{
	uint32_t temperature_value;

	LOG_DBG("Attribute read, handle: %u, conn: %p", attr->handle, conn);

	if (cb->temperature_cb) {
		temperature_value = cb->temperature_cb();
		return bt_gatt_attr_read(conn, attr, buf, len, offset, (void *) &temperature_value,
					 sizeof(temperature_value));
	}

	return 0;
}

/* Temperature Service Declaration */
BT_GATT_SERVICE_DEFINE(temperature_svc,
BT_GATT_PRIMARY_SERVICE(BT_UUID_CUSTOM_TEMP),
	BT_GATT_CHARACTERISTIC(BT_UUID_CUSTOM_TEMP_VALUE,
			       BT_GATT_CHRC_READ | BT_GATT_CHRC_NOTIFY,
			       BT_GATT_PERM_READ, read_temperature, NULL, NULL),
	BT_GATT_CCC(temperature_ccc_cfg_changed,
		    BT_GATT_PERM_READ | BT_GATT_PERM_WRITE),
	BT_GATT_CHARACTERISTIC(BT_UUID_CUSTOM_TEMP_INTERVAL,
			       BT_GATT_CHRC_WRITE,
			       BT_GATT_PERM_WRITE,
			       NULL, write_interval, NULL),
);

int bt_temperature_init(const struct bt_temperature_cb *callbacks)
{
	if (callbacks) {
		cb = callbacks;
	}

	return 0;
}

int bt_temperature_send_value(uint32_t temperature)
{
	if (!notify_enabled) {
		return -EACCES;
	}

	return bt_gatt_notify(NULL, &temperature_svc.attrs[2],
			      &temperature,
			      sizeof(temperature));
}
```

## src/temperature.h
```c
/*
 * Copyright (c) 2021 Nordic Semiconductor ASA
 *
 * SPDX-License-Identifier: LicenseRef-Nordic-5-Clause
 */

#ifndef TEMPERATURE_H_
#define TEMPERATURE_H_

#ifdef __cplusplus
extern "C" {
#endif

#include <zephyr/types.h>

/** @brief Temperature Service UUID. */
#define BT_UUID_CUSTOM_TEMP_VAL \
	BT_UUID_128_ENCODE(0x00001652, 0x741b, 0x4f7d, 0xadca, 0xe83cefb68df0)

/** @brief Temperature values Characteristic UUID. */
#define BT_UUID_CUSTOM_TEMP_VALUE_VAL \
	BT_UUID_128_ENCODE(0x00001653, 0x741b, 0x4f7d, 0xadca, 0xe83cefb68df0)

/** @brief Measurement interval Characteristic UUID. */
#define BT_UUID_CUSTOM_TEMP_INTERVAL_VAL \
	BT_UUID_128_ENCODE(0x00001654, 0x741b, 0x4f7d, 0xadca, 0xe83cefb68df0)

#define BT_UUID_CUSTOM_TEMP          BT_UUID_DECLARE_128(BT_UUID_CUSTOM_TEMP_VAL)
#define BT_UUID_CUSTOM_TEMP_VALUE    BT_UUID_DECLARE_128(BT_UUID_CUSTOM_TEMP_VALUE_VAL)
#define BT_UUID_CUSTOM_TEMP_INTERVAL BT_UUID_DECLARE_128(BT_UUID_CUSTOM_TEMP_INTERVAL_VAL)


/** @brief Callback type for when a temperature interval is received */
typedef void (*temperature_interval_cb_t)(const uint32_t interval);

/** @brief Callback type for when a temperature value is requested. */
typedef uint32_t (*temperature_cb_t)(void);

/** @brief Callback struct used by the Temperature Service. */
struct bt_temperature_cb {
	/** Temperature interval change callback. */
	temperature_interval_cb_t interval_cb;
	/** Temperature read callback. */
	temperature_cb_t temperature_cb;
};

/** @brief Initialize the Temperature Service.
 *
 * This function registers a GATT service with two characteristics: Temperature value
 * and Temperature measurement interval.
 * Send notifications for the Temperature value to let connected peers know
 * what is a current temperature value.
 * Write to the Temperature measurement characteristic to change the temperature measurement
 * interval board.
 *
 * @param[in] callbacks Struct containing pointers to callback functions
 *			used by the service. This pointer can be NULL
 *			if no callback functions are defined.
 *
 *
 * @retval 0 If the operation was successful.
 *           Otherwise, a (negative) error code is returned.
 */
int bt_temperature_init(const struct bt_temperature_cb *callbacks);

/** @brief Send the temperature value.
 *
 * This function sends a temperature value, to all connected peers.
 *
 * @param[in] temperature The current temperature value.
 *
 * @retval 0 If the operation was successful.
 *           Otherwise, a (negative) error code is returned.
 */
int bt_temperature_send_value(uint32_t temperature);

#ifdef __cplusplus
}
#endif

/**
 * @}
 */

#endif /* TEMPERATURE_H_ */
```
